/*
* Copyright (C) 2013 Matt Ranostay <mranostay@gmail.com>
*
* This program is free software; you can redistribute it and/or modify
* it under the terms of the GNU General Public License version 2 as
* published by the Free Software Foundation.
*/
/dts-v1/;
/plugin/;

/ {
	compatible = "ti,beaglebone", "ti,beaglebone-black";

	/* identification */
	part-number = "BB-JTAG-PRU";
	version = "00A0";

	/* state the resources this cape uses */
	exclusive-use =
		/* the pin header uses */
		"P9.27",	/* pru0: pr1_pru0_pru_r31_5 */
		"P9.25",	/* pru0: pr1_pru0_pru_r30_7 */
        "P8.12",    /* pru0: pr1_pru0_pru_r30_14*/
        "P8.11",    /* pru0: pr1_pru0_pru_r30_15*/
		/* the hardware IP uses */
		"pru0";

	fragment@0 {
		target = <&am33xx_pinmux>;
		__overlay__ {

			pru_pru_pins: pinmux_pru_pru_pins {
				pinctrl-single,pins = <
					0x1a4 0x26 	/* P9 27 GPIO3_19: mcasp0_fsr.gpio3[19] | MODE6 INPUT + INPUT ENABLE BIT*/
					0x1ac 0x05 	/* P9 25 GPIO3_21: mcasp0_ahclkx.gpio3[21] | MODE5 OUTPUT */
					0x030 0x06 	/* P8 12 GPIO1_12: gpmc_ad12.gpio1[12] | MODE6 OUTPUT */
					0x034 0x06 	/* P8 11 GPIO1_13: gpmc_ad13.gpio1[13] | MODE6 OUTPUT */
				>;
			};
		};	
	};

	fragment@2 {
		target = <&pruss>;
		__overlay__ {
			status = "okay";

			pinctrl-names = "default";
			pinctrl-0 = <&pru_pru_pins>;
		};
	};
};
